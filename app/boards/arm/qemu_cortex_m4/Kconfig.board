## app/boards/arm/qemu_cortex_m4/Kconfig.board
```kconfig
# SPDX-License-Identifier: Apache-2.0

config BOARD_QEMU_CORTEX_M4
	bool "QEMU Cortex-M4 Emulation"
	depends on SOC_TI_LM3S6965
	select QEMU_TARGET
```

## app/boards/arm/qemu_cortex_m4/Kconfig.defconfig
```kconfig
# SPDX-License-Identifier: Apache-2.0

if BOARD_QEMU_CORTEX_M4

config BOARD
	default "qemu_cortex_m4"

endif # BOARD_QEMU_CORTEX_M4
```
